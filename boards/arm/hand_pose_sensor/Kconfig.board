## boards/arm/hand_pose_sensor/Kconfig.board
```kconfig
config BOARD_HAND_POSE_SENSOR
	bool "Hand pose sensor"
	depends on SOC_NRF52840_QIAA
```

## boards/arm/hand_pose_sensor/Kconfig.defconfig
```kconfig
if BOARD_HAND_POSE_SENSOR

config BOARD
	default "hand_pose_sensor"

config BT_CTLR
	default BT

endif # BOARD_HAND_POSE_SENSOR
```

## boards/arm/hand_pose_sensor/hand_pose_sensor_defconfig
```kconfig
CONFIG_SOC_SERIES_NRF52X=y
CONFIG_SOC_NRF52840_QIAA=y
CONFIG_BOARD_HAND_POSE_SENSOR=y
CONFIG_ARM_MPU=y
CONFIG_HW_STACK_PROTECTION=y
CONFIG_USE_SEGGER_RTT=y
CONFIG_BT=y
CONFIG_GPIO=y
CONFIG_I2C=y
CONFIG_SERIAL=y
CONFIG_CONSOLE=y
CONFIG_LOG=y
CONFIG_UART_CONSOLE=y
CONFIG_I2C_TCA954X_ROOT_INIT_PRIO=61
CONFIG_I2C_TCA954X_CHANNEL_INIT_PRIO=62
```
